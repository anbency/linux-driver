## Kconfig
```kconfig
########add this to driver/Kconfig
source "drivers/miscdevice/Kconfig"
source "drivers/udevdevice/Kconfig"
source "drivers/procdevice/Kconfig"
source "drivers/sysdevice/Kconfig"
```

## drivingmodel/Kconfig
```kconfig
menu "my bus : mybus"

config MY_BUS

tristate "MY_BUS"

default y

    help
      Say 'Y' here, it will be compiled into thekernel; If you choose 'M', it will be compiled into a module named mybus.ko.

endmenu
```

## miscdevice/Kconfig
```kconfig
menu "my misc device: reverse"

config MY_MISC

tristate "MY_MISC"

default y

    help
      Say 'Y' here, it will be compiled into thekernel; If you choose 'M', it will be compiled into a module named asbq27501.ko.

endmenu
```

## procdevice/Kconfig
```kconfig
menu "my proc device: drvpp"

config MY_PROC_DEV

tristate "MY_PROC_DEV"

default y

    help
      Say 'Y' here, it will be compiled into thekernel; If you choose 'M', it will be compiled into a module named drvpp.ko.

endmenu
```

## sysdevice/Kconfig
```kconfig
menu "my sys device: sys_test"

config MY_SYS_DEV

tristate "MY_SYS_DEV"

default y

    help
      Say 'Y' here, it will be compiled into thekernel; If you choose 'M', it will be compiled into a module named sysdevice.ko.

endmenu
```

## udevdevice/Kconfig
```kconfig
menu "my udev device: drvee"

config MY_UDEV

tristate "MY_UDEV"

default y

    help
      Say 'Y' here, it will be compiled into thekernel; If you choose 'M', it will be compiled into a module named reverse.ko.

endmenu
```
